# file: asm_zero.ioc
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Mcu.Family=STM32F1
Mcu.Name=STM32F103C(8-B)Tx
Mcu.Package=LQFP48
NVIC.PriorityGroup=NVIC_PRIORITYGROUP_4
PA13.Mode=Serial_Wire
PA13.Signal=SYS_JTMS-SWDIO
PA14.Mode=Serial_Wire
PA14.Signal=SYS_JTCK-SWCLK
PC13-TAMPER-RTC.GPIO_Label=LED_BP
PC13-TAMPER-RTC.Signal=GPIO_Output
PC14-OSC32_IN.Mode=LSE-External-Oscillator
PC14-OSC32_IN.Signal=RCC_OSC32_IN
PC15-OSC32_OUT.Mode=LSE-External-Oscillator
PC15-OSC32_OUT.Signal=RCC_OSC32_OUT
PD0-OSC_IN.Mode=HSE-External-Oscillator
PD0-OSC_IN.Signal=RCC_OSC_IN
PD1-OSC_OUT.Mode=HSE-External-Oscillator
PD1-OSC_OUT.Signal=RCC_OSC_OUT
ProjectManager.HeapSize=0x200
ProjectManager.StackSize=0x400
ProjectManager.TargetToolchain=STM32CubeIDE
RCC.APB1Freq_Value=8000000
RCC.APB2Freq_Value=8000000
board=custom

// file: Core/Src/main.c
/* USER CODE BEGIN Header */
/**
 ******************************************************************************
 * @file           : main.c
 * @brief          : Main program body
 ******************************************************************************
 * @attention
 *
 * <h2><center>&copy; Copyright (c) 2021 STMicroelectronics.
 * All rights reserved.</center></h2>
 *
 * This software component is licensed by ST under BSD 3-Clause license,
 * the "License"; You may not use this file except in compliance with the
 * License. You may obtain a copy of the License at:
 *                        opensource.org/licenses/BSD-3-Clause
 *
 ******************************************************************************
 */
/* USER CODE END Header */
#include "main.h"

/* USER CODE BEGIN Includes */
#include "dwt.h"
#include <string.h>
/* USER CODE END Includes */

/* USER CODE BEGIN PD */
#define TICS_LED  (250)
#define LEN       (512)
/* USER CODE END PD */

/* USER CODE BEGIN PV */
uint32_t datos[LEN];
/* USER CODE END PV */

void SystemClock_Config(void);
static void MX_GPIO_Init(void);
/* USER CODE BEGIN PFP */
void zero(uint32_t *p, uint32_t len);
void zero_cbz(uint32_t *p, uint32_t len);
/* USER CODE END PFP */

int main(void)
{
	/* USER CODE BEGIN 1 */
	int i;
	uint32_t tics_led;
	uint32_t tiempos[5];
	/* USER CODE END 1 */

	/* MCU Configuration--------------------------------------------------------*/

	/* Reset of all peripherals, Initializes the Flash interface and the Systick. */
	HAL_Init();

	/* Configure the system clock */
	SystemClock_Config();

	/* Initialize all configured peripherals */
	MX_GPIO_Init();
	/* USER CODE BEGIN 2 */
	dwt_init();
	tics_led = HAL_GetTick();
	/* USER CODE END 2 */

	/* Infinite loop */
	/* USER CODE BEGIN WHILE */
	while (1)
	{
		/*
		 * Borro un vector con memset
		 *
		 */
		dwt_reset();
		memset(datos, 0, sizeof(datos));
		tiempos[0] = dwt_read();

		/*
		 * Borro un vector con un for
		 */
		for (i = 0; i < LEN; i++) {
			datos[i] = 0x55AA55AA;
		}
		dwt_reset();
		for (i = 0; i < LEN; i++) {
			datos[i] = 0;
		}
		tiempos[1] = dwt_read();

		/*
		 * Borro un vector usando punteros
		 */
		for (i = 0; i < LEN; i++) {
			datos[i] = 0x55AA55AA;
		}
		dwt_reset();
		uint32_t *p, *q;
		q = &datos[LEN-1];
		p = &datos[0];
		for (; p <= q; *p++ = 0);
		tiempos[2] = dwt_read();

		/*
		 * Borro un vector con código en assembler
		 */
		for (i = 0; i < LEN; i++) {
			datos[i] = 0x55AA55AA;
		}
		dwt_reset();
		zero(datos, LEN);
		tiempos[3] = dwt_read();

		/*
		 * Borro un vector con código en assembler que usa CBZ
		 */
		for (i = 0; i < LEN; i++) {
			datos[i] = 0x55AA55AA;
		}
		dwt_reset();
		zero_cbz(datos, LEN);
		tiempos[4] = dwt_read();

		UNUSED(tiempos);
		if ((HAL_GetTick() - tics_led) >= TICS_LED) {
			tics_led = HAL_GetTick();
			HAL_GPIO_TogglePin(LED_BP_GPIO_Port, LED_BP_Pin);
		}

		/* USER CODE END WHILE */

	}
}

void SystemClock_Config(void)
{
	RCC_OscInitTypeDef RCC_OscInitStruct = {0};
	RCC_ClkInitTypeDef RCC_ClkInitStruct = {0};

	/** Initializes the RCC Oscillators according to the specified parameters
	 * in the RCC_OscInitTypeDef structure.
	 */
	RCC_OscInitStruct.OscillatorType = RCC_OSCILLATORTYPE_HSI;
	RCC_OscInitStruct.HSIState = RCC_HSI_ON;
	RCC_OscInitStruct.HSICalibrationValue = RCC_HSICALIBRATION_DEFAULT;
	RCC_OscInitStruct.PLL.PLLState = RCC_PLL_NONE;
	if (HAL_RCC_OscConfig(&RCC_OscInitStruct) != HAL_OK)
	{
		Error_Handler();
	}
	/** Initializes the CPU, AHB and APB buses clocks
	 */
	RCC_ClkInitStruct.ClockType = RCC_CLOCKTYPE_HCLK|RCC_CLOCKTYPE_SYSCLK
			|RCC_CLOCKTYPE_PCLK1|RCC_CLOCKTYPE_PCLK2;
	RCC_ClkInitStruct.SYSCLKSource = RCC_SYSCLKSOURCE_HSI;
	RCC_ClkInitStruct.AHBCLKDivider = RCC_SYSCLK_DIV1;
	RCC_ClkInitStruct.APB1CLKDivider = RCC_HCLK_DIV1;
	RCC_ClkInitStruct.APB2CLKDivider = RCC_HCLK_DIV1;

	if (HAL_RCC_ClockConfig(&RCC_ClkInitStruct, FLASH_LATENCY_0) != HAL_OK)
	{
		Error_Handler();
	}
}

static void MX_GPIO_Init(void)
{
	GPIO_InitTypeDef GPIO_InitStruct = {0};

	/* GPIO Ports Clock Enable */
	__HAL_RCC_GPIOC_CLK_ENABLE();
	__HAL_RCC_GPIOD_CLK_ENABLE();
	__HAL_RCC_GPIOA_CLK_ENABLE();

	/*Configure GPIO pin Output Level */
	HAL_GPIO_WritePin(LED_BP_GPIO_Port, LED_BP_Pin, GPIO_PIN_RESET);

	/*Configure GPIO pin : LED_BP_Pin */
	GPIO_InitStruct.Pin = LED_BP_Pin;
	GPIO_InitStruct.Mode = GPIO_MODE_OUTPUT_PP;
	GPIO_InitStruct.Pull = GPIO_NOPULL;
	GPIO_InitStruct.Speed = GPIO_SPEED_FREQ_LOW;
	HAL_GPIO_Init(LED_BP_GPIO_Port, &GPIO_InitStruct);

}

void Error_Handler(void)
{
	__disable_irq();
	while (1)
	{
	}
}

/************************ (C) COPYRIGHT STMicroelectronics *****END OF FILE****/
